&pointing_listener {
    status = "okay";
    device = <&pointing_device>;
    input-processors = <&zip_xy_transform (INPUT_TRANSFORM_X_INVERT | INPUT_TRANSFORM_Y_INVERT)>, <&zip_xy_scaler 3 2>;

    scroll {
        layers = <7>;
        input-processors = <&zip_xy_to_scroll_mapper>, <&zip_scroll_scaler 1 16>;
    };
};
